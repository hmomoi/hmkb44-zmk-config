## boards/shields/hmkb44/Kconfig.defconfig
```kconfig
if SHIELD_HMKB44

    config ZMK_KEYBOARD_NAME
        default "hmkb44"

    config ZMK_BLE
        default y

    config RGBLED_WIDGET_BATTERY_LEVEL_HIGH
        default 30

    config RGBLED_WIDGET_BATTERY_LEVEL_CRITICAL
        default 10

endif
```

## config/west.yml
```yaml
manifest:
  remotes:
    - name: zmkfirmware
      url-base: https://github.com/zmkfirmware
    - name: caksoylar
      url-base: https://github.com/caksoylar
    - name: hmomoi
      url-base: https://github.com/hmomoi/hmkb44-zmk-config
    - name: prospector
      url-base: https://github.com/t-ogura
  projects:
    - name: zmk
      remote: zmkfirmware
      revision: main
      import: app/west.yml
    - name: zmk-rgbled-widget
      remote: caksoylar
      revision: main
      # Add this:
    - name: prospector-zmk-module
      remote: prospector
      revision: v2.1.0  # Use v2.0.0 for ZMK ≤0.3 (Zephyr 3.x)
      path: modules/prospector-zmk-module
  self:
    path: config
```
